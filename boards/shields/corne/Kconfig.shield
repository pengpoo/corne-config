## boards/shields/corne/Kconfig.shield
```kconfig
# Copyright (c) 2020 Pete Johanson
# SPDX-License-Identifier: MIT

config SHIELD_CORNE_L
	def_bool $(shields_list_contains,custom_corne_l)

config SHIELD_CORNE_R
	def_bool $(shields_list_contains,custom_corne_r)
```

## boards/shields/nice_view_config/Kconfig.shield
```kconfig
config SHIELD_NICE_VIEW_CONFIG
    def_bool $(shields_list_contains,nice_view_config)
```
